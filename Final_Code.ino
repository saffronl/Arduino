/* Water Safety Project
* April 4th, 2022 
* CPLN571 Sensing the City 
* University of Pennsylvania 
* Saffron Livaccari, Jie Wang, Jiali Yao, Yebei Yao

 code is adapted from:
 https://circuitdigest.com/microcontroller-projects/arduino-ph-meter and ELEGOO Lessons 15 
 https://lastminuteengineers.com/water-level-sensor-arduino-tutorial/ 
 https://randomnerdtutorials.com/guide-for-oled-display-with-arduino/
 https://create.arduino.cc/projecthub/najad/interfacing-and-displaying-images-on-oled-59344a

*/
#include <OneWire.h> // load the library for LCD display
#include <DallasTemperature.h> // load the library for Temperature
#include <ArducamSSD1306.h>    // Modification of Adafruit_SSD1306 for ESP8266 compatibility (from github package)
#include <Adafruit_GFX.h>   // Needs a little change in original Adafruit library (See README.txt file)
#include <Wire.h>           // For I2C comm, but needed for not getting compile error

// For OLED Screen:
#define OLED_RESET  16  // Pin 15 -RESET digital signal
#define LOGO16_GLCD_HEIGHT 16
#define LOGO16_GLCD_WIDTH  16
ArducamSSD1306 display(OLED_RESET); // FOR I2C

// For sensors:
#define PH_PIN A0 // ph input
#define Turbidity_PIN A1 // turbidity input
#define ONE_WIRE_BUS 5 // for temperature, connect temperature yellow pin to Pin5
#define waterSensor 4 // for water level
#define sensorPin A2 // for water level

// For LED Light:
#define BLUE 2
#define GREEN 3
#define RED 6


/// For temperature sensor:
// Setup a oneWire instance to communicate with any OneWire devices
OneWire oneWire(ONE_WIRE_BUS);
// Pass our oneWire reference to Dallas Temperature sensor 
DallasTemperature sensors(&oneWire);
/// For temperature:
int buffer_arr[10],temp; // define an array for later data smoothing
int delaytime = 3000;


/// For pH value:
float calibration_value = 21.34 + 2; // could "+/-" a number to adjust the calibration value based on the pH of distilled water
int phval = 0; // set the initial ph value as 0
unsigned long int avgval;
float volt_ph;
float ph_act;


/// For water level sensor:
int val = 0;
float heavyRain = 8.33; //0.0000000833 inches per milliseconds * 100000000 
// Since the float value only stores 6 decimals, and 0.0000000833 is longer than 6 decimals, 
// multiply this value by "100000000" to get a value that can be stored as a float 
float intensity;
int one_half_Inches = 500; // Change this value based on your sensor's calibration
volatile unsigned long timer0_millis; // reset the timer back to 0

/// For turbidity:
float ntu;
float volt_turbidity = 0;

////////////////////////////////////////////////////////////////////////
/////////////////// IMAGES FOR OLED SCREEN //////////////////
const unsigned char swim [] PROGMEM = {
  0x00, 0x00, 0x00, 0x00, 0x00, 0x00, 0x00, 0x00, 0x00, 0x00, 0x00, 0x00, 0x00, 0x00, 0x00, 0x00, 
  0x00, 0x00, 0x00, 0x00, 0x00, 0x00, 0x00, 0x00, 0x00, 0x00, 0x00, 0x00, 0x00, 0x00, 0x00, 0x00, 
  0x00, 0x00, 0x00, 0x00, 0x00, 0x00, 0x00, 0x00, 0x00, 0x00, 0x00, 0x00, 0x00, 0x00, 0x00, 0x00, 
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  0x00, 0x00, 0x00, 0x00, 0x00, 0x00, 0x00, 0x00, 0x00, 0x00, 0x00, 0x00, 0x00, 0x00, 0x00, 0x00
};
const unsigned char flood_rising [] PROGMEM = {
  0x00, 0x00, 0x00, 0x00, 0x00, 0x00, 0x00, 0x00, 0x00, 0x00, 0x00, 0x00, 0x00, 0x00, 0x00, 0x00, 
  0x00, 0x00, 0x00, 0x00, 0x00, 0x00, 0x00, 0x00, 0x00, 0x00, 0x00, 0x00, 0x00, 0x00, 0x00, 0x00, 
  0x00, 0x00, 0x00, 0x00, 0x00, 0x00, 0x00, 0x00, 0x00, 0x00, 0x00, 0x00, 0x00, 0x00, 0x00, 0x00, 
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  0x00, 0x00, 0x00, 0x00, 0x00, 0x00, 0x00, 0x00, 0x00, 0x00, 0x00, 0x00, 0x00, 0x00, 0x00, 0x00
};

const unsigned char cloud_flood [] PROGMEM = {
  0x00, 0x00, 0x00, 0x00, 0x00, 0x00, 0x00, 0x7e, 0x00, 0x00, 0x00, 0x00, 0x00, 0x00, 0x00, 0x00, 
  0x00, 0x00, 0x00, 0x00, 0x00, 0x00, 0x00, 0xff, 0x80, 0x00, 0x00, 0x00, 0x00, 0x00, 0x00, 0x00, 
  0x00, 0x00, 0x00, 0x00, 0x00, 0x00, 0x01, 0xff, 0xc0, 0x00, 0x00, 0x00, 0x00, 0x00, 0x00, 0x00, 
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  0x00, 0x00, 0x00, 0x00, 0x00, 0x0e, 0x03, 0xf8, 0x07, 0xf0, 0x1e, 0x00, 0x00, 0x00, 0x00, 0x00
};

// 'Screen Shot 2022-04-18 at 10', 128x40px
const unsigned char fishing [] PROGMEM = {
  0x00, 0x00, 0x00, 0x00, 0x00, 0x00, 0x00, 0x00, 0x00, 0x00, 0x00, 0x00, 0x00, 0x00, 0x00, 0x00, 
  0x00, 0x00, 0x00, 0x00, 0x00, 0x00, 0x00, 0x00, 0x00, 0x00, 0x00, 0x00, 0x00, 0x00, 0x00, 0x00, 
  0x00, 0x00, 0x00, 0x00, 0x00, 0x00, 0x00, 0x00, 0x00, 0x00, 0x00, 0x00, 0x00, 0x00, 0x00, 0x00, 
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  0x00, 0x00, 0x00, 0x00, 0x00, 0x00, 0x00, 0x00, 0x00, 0x00, 0x00, 0x00, 0x00, 0x00, 0x00, 0x00
};
// 'Screen Shot 2022-04-18 at 10', 128x40px
const unsigned char temperature [] PROGMEM = {
  0x00, 0x00, 0x00, 0x00, 0x00, 0x00, 0x03, 0xe0, 0x00, 0x1f, 0x00, 0x00, 0x00, 0x00, 0x00, 0x00, 
  0x00, 0x00, 0x00, 0x00, 0x00, 0x00, 0x0f, 0xf8, 0x00, 0x7f, 0xc0, 0x00, 0x00, 0x00, 0x00, 0x00, 
  0x00, 0x00, 0x00, 0x00, 0x00, 0x00, 0x1f, 0xfe, 0x00, 0xff, 0xe0, 0x00, 0x00, 0x00, 0x00, 0x00, 
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  0x00, 0x00, 0x00, 0x00, 0x00, 0x00, 0x00, 0x00, 0x00, 0x00, 0x00, 0x00, 0x00, 0x00, 0x00, 0x00
};
// 'Screen Shot 2022-04-18 at 10', 128x40px
const unsigned char boat [] PROGMEM = {
  0x00, 0x00, 0x00, 0x00, 0x00, 0x00, 0x00, 0x03, 0x00, 0x00, 0x00, 0x00, 0x00, 0x00, 0x00, 0x00, 
  0x00, 0x00, 0x00, 0x00, 0x00, 0x00, 0x00, 0x03, 0x80, 0x00, 0x00, 0x00, 0x00, 0x00, 0x00, 0x00, 
  0x00, 0x00, 0x00, 0x00, 0x00, 0x00, 0x00, 0x03, 0x80, 0x00, 0x00, 0x00, 0x00, 0x00, 0x00, 0x00, 
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  0x00, 0x00, 0x00, 0x00, 0x00, 0x00, 0x00, 0x00, 0x00, 0x00, 0x00, 0x00, 0x00, 0x00, 0x00, 0x00
};
const unsigned char good [] PROGMEM = {
  0x00, 0x00, 0x00, 0x00, 0x00, 0x00, 0x00, 0x1f, 0xf0, 0x00, 0x00, 0x00, 0x00, 0x00, 0x00, 0x00, 
  0x00, 0x00, 0x00, 0x00, 0x00, 0x00, 0x00, 0xff, 0xfe, 0x00, 0x00, 0x00, 0x00, 0x00, 0x00, 0x00, 
  0x00, 0x00, 0x00, 0x00, 0x00, 0x00, 0x03, 0xff, 0xff, 0x80, 0x00, 0x00, 0x00, 0x00, 0x00, 0x00, 
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  0x00, 0x00, 0x00, 0x00, 0x00, 0x00, 0x00, 0x1f, 0xf0, 0x00, 0x00, 0x00, 0x00, 0x00, 0x00, 0x00
};
const unsigned char do_not_enter [] PROGMEM = {
  0x00, 0x00, 0x00, 0x00, 0x00, 0x00, 0x00, 0x00, 0x00, 0x00, 0x00, 0x00, 0x00, 0x00, 0x00, 0x00, 
  0x00, 0x00, 0x00, 0x00, 0x00, 0x00, 0x00, 0x07, 0xe0, 0x00, 0x00, 0x00, 0x00, 0x00, 0x00, 0x00, 
  0x00, 0x00, 0x00, 0x00, 0x00, 0x00, 0x00, 0x7f, 0xfe, 0x00, 0x00, 0x00, 0x00, 0x00, 0x00, 0x00, 
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  0x00, 0x00, 0x00, 0x00, 0x00, 0x00, 0x00, 0x00, 0x00, 0x00, 0x00, 0x00, 0x00, 0x00, 0x00, 0x00
};
const unsigned char no_swim [] PROGMEM = {
  0x00, 0x00, 0x00, 0x00, 0x00, 0x00, 0x00, 0x1f, 0xe0, 0x00, 0x00, 0x00, 0x00, 0x00, 0x00, 0x00, 
  0x00, 0x00, 0x00, 0x00, 0x00, 0x00, 0x01, 0xff, 0xfe, 0x00, 0x00, 0x00, 0x00, 0x00, 0x00, 0x00, 
  0x00, 0x00, 0x00, 0x00, 0x00, 0x00, 0x07, 0xff, 0xff, 0x80, 0x00, 0x00, 0x00, 0x00, 0x00, 0x00, 
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  0x00, 0x00, 0x00, 0x00, 0x00, 0x00, 0x00, 0x1f, 0xe0, 0x00, 0x00, 0x00, 0x00, 0x00, 0x00, 0x00
};
const unsigned char no_boat [] PROGMEM = {
  0x00, 0x00, 0x00, 0x00, 0x00, 0x00, 0x00, 0x0f, 0xe0, 0x00, 0x00, 0x00, 0x00, 0x00, 0x00, 0x00, 
  0x00, 0x00, 0x00, 0x00, 0x00, 0x00, 0x00, 0xff, 0xfe, 0x00, 0x00, 0x00, 0x00, 0x00, 0x00, 0x00, 
  0x00, 0x00, 0x00, 0x00, 0x00, 0x00, 0x03, 0xff, 0xff, 0x80, 0x00, 0x00, 0x00, 0x00, 0x00, 0x00, 
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  0x00, 0x00, 0x00, 0x00, 0x00, 0x00, 0x00, 0x1f, 0xf0, 0x00, 0x00, 0x00, 0x00, 0x00, 0x00, 0x00
};
const unsigned char no_fishing [] PROGMEM = {
  0x00, 0x00, 0x00, 0x00, 0x00, 0x00, 0x00, 0x1f, 0xf0, 0x00, 0x00, 0x00, 0x00, 0x00, 0x00, 0x00, 
  0x00, 0x00, 0x00, 0x00, 0x00, 0x00, 0x00, 0xff, 0xff, 0x00, 0x00, 0x00, 0x00, 0x00, 0x00, 0x00, 
  0x00, 0x00, 0x00, 0x00, 0x00, 0x00, 0x03, 0xff, 0xff, 0xc0, 0x00, 0x00, 0x00, 0x00, 0x00, 0x00, 
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  0x00, 0x00, 0x00, 0x00, 0x00, 0x00, 0x00, 0x1f, 0xf8, 0x00, 0x00, 0x00, 0x00, 0x00, 0x00, 0x00
};
const unsigned char sun [] PROGMEM = {
  0x00, 0x00, 0x00, 0x00, 0x00, 0x00, 0x00, 0x00, 0x00, 0x00, 0x00, 0x00, 0x00, 0x00, 0x00, 0x00, 
  0x00, 0x00, 0x00, 0x00, 0x00, 0x00, 0x00, 0x00, 0x80, 0x00, 0x00, 0x00, 0x00, 0x00, 0x00, 0x00, 
  0x00, 0x00, 0x00, 0x00, 0x00, 0x00, 0x00, 0x01, 0xc0, 0x00, 0x00, 0x00, 0x00, 0x00, 0x00, 0x00, 
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  0x00, 0x00, 0x00, 0x00, 0x00, 0x00, 0x00, 0x00, 0x00, 0x00, 0x00, 0x00, 0x00, 0x00, 0x00, 0x00
};
////////////////////////////////////////////////////////////////////////
////////////////////////////////////////////////////////////////////////




void setup() {
  lcd.begin(16, 2); // set the LCD display as 16 columns and 2 rows
  pinMode(waterSensor, OUTPUT); // for water level sensor
  digitalWrite(waterSensor, LOW); // Set to LOW so no power flows through the sensor
  pinMode(RED, OUTPUT);
  pinMode(GREEN, OUTPUT);
  pinMode(BLUE, OUTPUT);// RGB LED
  Serial.begin(9600); // the serial monitor setting
  sensors.begin();
  display.begin(); //or 0x3C
  display.clearDisplay(); //for Clearing the display
}



void loop() { 
  
  //################## for pH ##################
  //read 10 sample analog values and store them in an array to smooth the output value.
  for(int i=0;i<10;i++) { 
    buffer_arr[i]=analogRead(PH_PIN); // create an array of 10 and fill in the array with PH values
    delay(30);
    }
    //sort the Analog values received in ascending order, because we need to calculate the 
    //running average of samples later
   for(int i=0;i<9;i++) {
    for(int j=i+1;j<10;j++) {
      if(buffer_arr[i]>buffer_arr[j]) {
        temp=buffer_arr[i];
        buffer_arr[i]=buffer_arr[j];
        buffer_arr[j]=temp;
        }
     }
   }
   
   //calculate the average of a 6 centre sample Analog values
   avgval = 0;
   for(int i=2;i<8;i++)
   avgval += buffer_arr[i];
   
   //converted the average analog value into actual pH value
   volt_ph = (float)avgval*5.0/1024/6;
   ph_act = -5.70 * volt_ph + calibration_value;
   
   // ################## for Turbidity ##################
   for(int i=0; i<800; i++) {
        volt_turbidity += ((float)analogRead(Turbidity_PIN)/1024)*5;
    }
    volt_turbidity = volt_turbidity/800;
    volt_turbidity = round_to_dp(volt_turbidity,1);
    if(volt_turbidity < 2.5){ // if the voltage is too low, read a high turbidity
      ntu = 3000;
    }
    else{ // convert voltage to NTU
      ntu = (-1120.4*(volt_turbidity*volt_turbidity)) + (5742.3*volt_turbidity) -4353.8; 
    }

    // Calcalatees a safety value based on pH and turbidity !
    int safety_value = safety(ph_act, ntu); // this function is written below !

    // ################## Temperature ##################
    sensors.requestTemperatures();
    int temp =  sensors.getTempFByIndex(0);

    // ################## Print on the OLED Screen ##################
    PrintLED(ph_act, ntu, temp, safety_value); // this will print the readings of every sensor to the OLED screen
    
    // ################## Water Level ##################
    int level = readSensor(); // the water level from the sensor

    if (level == 0) { // if no water is detected
     //// if there is no rainfall happening, just print out all the values on the OLED screen
       PrintLED(ph_act, ntu, temp, safety_value);
    }
    if (level > 0) { // if there is water detected
       //if rainfall is detected, start timer
      noInterrupts ();
      timer0_millis = 0; // reset the timer first
      interrupts ();
      timer0_millis = millis(); // start the timer
    
       // if water level hits >= fullySubmerged, get the time and calculate speed
       if (level >= one_half_Inches){ // fullySubmerged reading is roughly 1.5 inches

          intensity = intensity_converted(timer0_millis);
          Serial.print("Intensity (in/millis): ");
          Serial.println(intensity);
      
          if (intensity >= heavyRain){ // if the rainfall speed is greater than .3 in/hour
            Serial.print("The rainfall intensity is: ");
            Serial.println(intensity);
            Serial.println("The rainfall is very heavy! Flood Warning!");

            int i = 0;
            while (i<5) { // change to 13,500 if want to last a whole day
              Flood_Warning()
              i++;}
            }
           
          else { // If it isnt heavy rainfall
            noInterrupts ();
            timer0_millis = 0; // reset timer back to 0
            interrupts (); 
            
            // If there is no heavy rainfall, just print out normal readings on the LCD Screen
            PrintLED(ph_act, ntu, temp, safety_value);
            }
        }
    }

    // ################## Print values on the Serial Monitor ##################
    // print the pH value in serial monitor:
    Serial.print("pH Val: ");
    Serial.println(ph_act);  // ph value
    Serial.print("Turbidity Val: ");
    Serial.println(ntu); // turbidity value
    // Serial.print(volt2);
    Serial.print("Celsius temperature: "); // Temperature
    Serial.println(sensors.getTempCByIndex(0)); 
    Serial.print("Fahrenheit temperature: ");
    Serial.println(temp);
    Serial.print("Water Level: "); // Water level
    Serial.println(level);
    Serial.print("Contact safe?   ");
    safety_SerialMonitor(safety_value); // prints contact safe on serial monitor
    Serial.println("");
    delay(delaytime);
}


// Function for Turbidity
float round_to_dp(float in_value, int decimal_place) {
  float multiplier = powf( 10.0f, decimal_place );
  in_value = roundf( in_value * multiplier ) / multiplier;
  return in_value;
}


// Function for reading Water Level
int readSensor() {
  digitalWrite(waterSensor, HIGH);
  delay(10); // wait 10 milliseconds
  val = analogRead(sensorPin);
  digitalWrite(waterSensor, LOW);
  return val;
  delay(1000); // only read sensor every 15 minutes
}


// Function for calculated rainfall intensity
float intensity_converted(float milliseconds) {
  return (1.5/(milliseconds)* 100000000);
  // Rainfall intensity is .3 inches per hour for Heavy Rainfall
  // This equation has '1.5' becuase we set our trigger (variable one_half_Inches)
  // to be equivalent to 1.5 inches, and rainfall intensity is measured as inches per hour
  // currentMillis/3600000 converts milliseconds to hour
}


// Function that determines safety of water contact
int safety(float ph_funct, float ntu_funct) {
  int safety_num;
  if (ph_funct<6.5 || ph_funct>8.5) { // if pH is outside of 6.5 to 8.5 range
    if (ntu_funct > 50) { // if turbidity is higher than 50
      safety_num = 2; // 2 for high turb AND out of range
    }
    else { // if turbidity < 50
      safety_num = 1; // 1 for out of range pH only, but turbidity is in range
    }
  }
  else { // if turbidity is inside the range of 6.5 to 8.5
    if (ntu_funct > 50) {
      safety_num = 1; // 1 for high turb only, pH is safe
    }
    else {// pH normal and turbidity is <50
      safety_num = 0;
    }
  }
  return safety_num;

  // Safe Values are
  // ph between 6.5 and 8.5
  // turbidity below 50
}


// Function that prints out the safety onto serial monitor
void safety_SerialMonitor(int value) {
  if (value == 2) {
    Serial.println("Not safe for contact");
  }
  else if (value == 1) {
    Serial.println("Safe for fishing or boating ONLY");
  }
  else if (value == 0) {
    Serial.println("Safe for swimming");
  }
  else {
    Serial.println("Out of Range");
  }
}


// Function that prints out the safety onto OLED Screen
void safety_LCD(int value) {
  display.invertDisplay(false); // set up display to be black
  display.setTextSize(2);
  display.setTextColor(WHITE);
  
  if (value == 2) {
    i=0;
    while (i<2) {
      display.clearDisplay();
      display.drawBitmap(0, 20, no_fishing, 128, 40, WHITE);
      display.display();
      delay(1000); 
      display.clearDisplay();
      display.drawBitmap(0, 20, no_swim, 128, 40, WHITE);
      display.display();
      delay(1000);
      display.clearDisplay();
      display.drawBitmap(0, 20, no_boat, 128, 40, WHITE);
      display.display();
      delay(1000); 
      i++;
    }
    i=0;
    while (i<8) {
      display.invertDisplay(false);
      display.clearDisplay();
      display.drawBitmap(0, 20, do_not_enter, 128, 40, WHITE);
      display.display();
      delay(400);
      display.invertDisplay(true);
      display.clearDisplay();
      display.drawBitmap(0, 20, do_not_enter, 128, 40, WHITE);
      display.display();
      delay(400);
      i++;
     } 
  }
  else if (value == 1) {
    i=0;
    while (i<2) {
      display.clearDisplay();
      display.drawBitmap(-30, 20, fishing, 128, 40, WHITE);
      display.drawBitmap(40, 20, good, 128, 40, WHITE);
      display.display();
      delay(1000);
      display.clearDisplay();
      display.drawBitmap(-30, 20, boat, 128, 40, WHITE);
      display.drawBitmap(40, 20, good, 128, 40, WHITE);
      display.display();
      delay(1000);
      display.clearDisplay();
      display.drawBitmap(0, 20, no_swim, 128, 40, WHITE);
      display.display();
      delay(2000);
      i++;
    }
  }
  else if (value == 0) {
    i = 0;
    while (i<2) {
      display.clearDisplay();
      display.drawBitmap(-30, 20, fishing, 128, 40, WHITE);
      display.drawBitmap(40, 20, good, 128, 40, WHITE);
      display.display();
      delay(1000);
      display.clearDisplay();
      display.drawBitmap(-30, 20, boat, 128, 40, WHITE);
      display.drawBitmap(40, 20, good, 128, 40, WHITE);
      display.display();
      delay(1000);
      display.clearDisplay();
      display.drawBitmap(-30, 20, swim, 128, 40, WHITE);
      display.drawBitmap(40, 20, good, 128, 40, WHITE);
      display.display();
      delay(1000);
      i++; }
    display.clearDisplay();
    display.setCursor(37,20);
    display.println("ENJOY!");
    display.display();
    delay(1000);
    display.clearDisplay();
    display.drawBitmap(0, 20, sun, 128, 40, WHITE);
    display.display();
    delay(5000);
  }
  else {
    display.clearDisplay();
    display.setCursor(1,20);
    display.println("Out of");
    display.setCursor(1,40);
    display.println("range");
    display.display();
    delay(1000);
  }
}


// Function for printing on OLED Screen
void PrintLED(float ph_funct, float ntu_funct, int temp_funct, int safety_funct) {
  display.invertDisplay(false); // set up display to be black
  display.setTextSize(2);
  display.setTextColor(WHITE);
  
  display.clearDisplay(); // ph
  display.setCursor(15,20);
  display.println("pH Value:");
  display.setCursor(37,40);
  display.println(ph_funct);
  display.display(); 
  delay(1000);

  display.clearDisplay();
  display.setCursor(1,20);
  display.println("Turbidity:");
  display.setCursor(7,40);
  display.println(ntu_funct);
  display.setCursor(85,46);
  display.setTextSize(1);
  display.println("NTU");
  display.display(); 
  delay(1000);

  display.clearDisplay();
  display.setTextSize(2);
  display.setCursor(38,20);
  display.println("Temp:");
  display.setCursor(50,40);
  display.println(temp_funct);
  display.setCursor(83,46);
  display.setTextSize(1);
  display.println("F");
  display.display(); 
  delay(1000);

  safety_LCD(safety_funct); // contact safe ?
  delay(500);
}

void Flood_Warning() {
  // this loop lasts 6.4 seconds in total
  // in order to make this last 24 hours, it will need to run
  // for 86400 seconds in total
  // or loop 13,500 times
  display.clearDisplay();
  int x = 0;
  while (x <3) { //this loop lasts 1,200 ms or 1.2 seconds
    display.clearDisplay();
    display.invertDisplay(true);
    display.setTextSize(2);
    display.setTextColor(WHITE);
    display.setCursor(33,20);
    display.println("HEAVY");
    display.setCursor(37,40);
    display.println("RAIN");
    display.display();
    delay(200);
    display.clearDisplay();
    display.invertDisplay(false);
    display.setCursor(33,20);
    display.println("HEAVY");
    display.setCursor(37,40);
    display.println("RAIN");
    display.display();
    delay(200);
    x++;}
  x = 0;
  while (x<5) { //this loop lasts 2,000 ms or 2 seconds
    display.invertDisplay(true);
    display.clearDisplay();
    display.drawBitmap(0, 20, cloud_flood, 128, 40, WHITE);
    display.display();
    delay(200);
    display.invertDisplay(false);
    display.clearDisplay();
    display.drawBitmap(0, 20, cloud_flood, 128, 40, WHITE);
    display.display();
    delay(200);
    x++;}
  x = 0;
  while (x<3) { //this loop lasts 1,200 ms or 1.2 seconds
    display.clearDisplay();
    display.invertDisplay(true);
    display.setCursor(32,20);
    display.println("FLOOD");
    display.setCursor(22,40);
    display.println("WARNING");
    display.display();
    delay(200);
    display.clearDisplay();
    display.invertDisplay(false);
    display.setCursor(32,20);
    display.println("FLOOD");
    display.setCursor(22,40);
    display.println("WARNING");
    display.display();
    delay(200);
    x ++;}
  x=0;
  while (x<5) { //this loop lasts 2,000 ms or 2 seconds
    display.invertDisplay(true);
    display.clearDisplay();
    display.drawBitmap(0, 10, flood_rising, 128, 50, WHITE);
    display.display();
    delay(200);
    display.invertDisplay(false);
    display.clearDisplay();
    display.drawBitmap(0, 10, flood_rising, 128, 50, WHITE);
    display.display();
    delay(200);
    x++;} 
}
